## components/audio_device/Kconfig
```kconfig
menu "Tab5 audio device arbitration"

    config MQJS_TAB5_AUDIO_DEVICE_SELFTEST
        bool "Boot-time audio_device token self-test"
        depends on MQJS_TAB5_AUDIO
        default n
        help
            Exercise the audio_device P1 exclusive-token layer on real
            hardware shortly after boot: submit two overlapping requests so
            the first is granted immediately and the second queues, play a
            short beep through each granted token (audio_request ->
            audio_stream_write -> audio_stream_finish), and log the
            grant/queue/dispatch sequence plus audio_tab5 stats. Verifies
            the manager task, token validation, and backend hand-off without
            touching the existing tone/WAV producers. Leave off in shipping
            builds.

endmenu
```

## components/audio_tab5/Kconfig
```kconfig
menu "Tab5 audio output"

    config MQJS_TAB5_AUDIO
        bool "Enable Tab5 audio output (ES8388 + I2S)"
        default n
        depends on IDF_TARGET_ESP32P4
        help
            PCM playback path for the M5Stack Tab5 speaker: ES8388 codec
            (esp_codec_dev driver, shared ui_tab5 I2C bus), I2S TX on
            MCLK=G30/BCLK=G27/WS=G29/DOUT=G26, SPK_EN on the 0x43 IO
            expander P1, and a PSRAM PCM ring buffer drained by a writer
            task. Off by default so Stamp-P4 builds are unaffected; when
            disabled audio_tab5.h provides no-op inline stubs.

    config MQJS_TAB5_AUDIO_RING_KB
        int "PCM ring buffer size (KB, PSRAM)"
        depends on MQJS_TAB5_AUDIO
        default 64
        help
            Bounded PCM queue between the decoder/producer and the I2S
            writer task. 64 KB is ~340 ms of 48 kHz stereo 16-bit audio.

    config MQJS_TAB5_AUDIO_SELFTEST
        bool "Boot-time speaker self-test tone"
        depends on MQJS_TAB5_AUDIO
        default n
        help
            Play two short beeps ~3 s after boot and log ring/underrun
            telemetry. P2 gate of docs/opus-decoder-plan.md: verifies the
            PCM path (I2S + ES8388 + SPK_EN) without any codec involved.

    config MQJS_TAB5_AUDIO_BOOT_WAV
        bool "Embed assets/audio/tab5-boot.wav in the firmware"
        depends on MQJS_TAB5_AUDIO
        default n
        help
            Embed the WAV at assets/audio/tab5-boot.wav (16-bit PCM) into
            the binary so it can be played without a filesystem, via
            audio.playWav() / audio_tab5_play_boot_wav(). The asset is
            ~1.2 MB and grows every flash — leave off unless testing the
            real-audio playback path.

    config MQJS_TAB5_AUDIO_BOOT_WAV_AUTOPLAY
        bool "Play the embedded boot WAV ~3 s after boot"
        depends on MQJS_TAB5_AUDIO_BOOT_WAV
        default n
        help
            Fire audio_tab5_play_boot_wav() shortly after boot (shares the
            self-test delay path). Handy for a hands-off playback check.

endmenu
```

## components/cam_tab5/Kconfig
```kconfig
menu "mqjs Tab5 camera"

config MQJS_CAMERA
    bool "Tab5 camera barcode scanning (camera.scan JS API)"
    default n
    depends on IDF_TARGET_ESP32P4
    help
        SC2356 over MIPI-CSI via esp_video; EAN-13 scanline decoding
        for ISBN input. Needs the Tab5 UI build (shares the touch
        controller's I2C bus for SCCB) and the esp_video kconfig
        options from sdkconfig.tab5.defaults.

endmenu
```

## components/sshc/Kconfig
```kconfig
menu "SSH client (mqjs ssh.*)"

    config MQJS_SSH
        bool "Enable the SSH client bindings (wolfSSH)"
        default n
        help
            Build the wolfSSH-based SSH client task and expose it to JS
            as ssh.connect / write / resize / close / onData / onClose.
            Adds wolfSSL+wolfSSH to the image (a few hundred KB). Off by
            default; when disabled sshc.h provides no-op inline stubs so
            Stamp builds are unaffected.

endmenu
```
