## main/Kconfig.projbuild
```kconfig
menu "mqjs platform"

    config MQJS_WIFI_SSID
        string "WiFi SSID (empty = WiFi disabled)"
        default ""
        help
            SSID of the access point the Stamp-AddOn C6 should join.
            Leave empty to skip WiFi bring-up entirely.

    config MQJS_WIFI_PASSWORD
        string "WiFi password"
        default ""

    config MQJS_TAB5_POWER
        bool "M5Stack Tab5: enable C6 WLAN power via PI4IOE expander"
        default n
        help
            On Tab5 the esp-hosted C6 is power-gated by an IO expander
            (PI4IOE5V6408 @0x44, internal I2C). Enable for Tab5 builds
            so WiFi works; leave off for Stamp-P4.

    config MQJS_TAILSCALE
        bool "Tailscale (microlink) VPN client"
        default n
        help
            Build the microlink-based Tailscale client + lifecycle adapter
            and let the device join a tailnet from the System Vault auth key
            (started via the Wi-Fi got-IP callback chain). Pulls microlink and
            its WireGuard/cJSON/HTTP deps into the image. Off by default; when
            disabled the adapter compiles to no-op stubs so Stamp builds are
            unaffected. Needs PSA ChaCha20-Poly1305 (MBEDTLS_CHACHAPOLY_C).

    config MQJS_TASK_BROKER
        string "Task source MQTT broker URI"
        default "mqtt://test.mosquitto.org"
        help
            Broker the task-source client connects to for receiving
            replacement JS tasks.

    config MQJS_TASK_TOPIC
        string "Task source topic (empty = disabled)"
        default "esp32p4-mqjs/task/u7q3x9f2"
        help
            JS source published to this topic replaces the running task.
            No signature verification yet: on a public broker the topic
            name is the only secret, pick a non-guessable one.

    config MQJS_DEV_ARENA_KB
        int "Dev-slot JS arena size override in KB (0 = default 256, PSRAM)"
        default 0
        range 0 256
        help
            A/B probe for the PSRAM-arena tax on the JS interpreter
            (pointer-chasing is latency-bound; nobody has measured what
            PSRAM costs this workload). Overrides the dev worker's arena
            size only — every other slot keeps the 256 KB PSRAM arena and
            the app model is untouched. Compare 96 KB PSRAM against 96 KB
            internal (below) with the same bench, NOT against the 256 KB
            default: a different arena size changes GC cadence, which
            would confound the comparison.

    config MQJS_DEV_ARENA_INTERNAL
        bool "Place the dev-slot arena in internal L2 SRAM"
        default n
        help
            The other half of the A/B. Only sensible with
            MQJS_DEV_ARENA_KB small enough to leave L2MEM room for the
            camera scan scratch and network bursts (96 KB is the tested
            point). Falls back to PSRAM with a warning if the internal
            allocation fails at boot. Dev probe only — never ship.

    config MQJS_FLASH_STALL_METER
        bool "Count the cache stalls that flash writes cause"
        default n
        help
            Wraps the IDF guard that disables the caches and parks the
            other core during a flash erase or program, and counts how
            often it happens, for how long, and how much of that landed
            within 1.5 s of a keystroke.

            That last ratio is the whole point. A stall costs core 1
            about 40% of its throughput, but it only HURTS when it lands
            on typing. Removing it costs roughly 12 MB of PSRAM and 1.3 s
            of boot (XIP plus a PSRAM copy of the dictionary), so the
            decision needs the number rather than an argument. See
            docs/native-editor-design.md section 6.4.

            Cheap: two counters and a CSR read per stall. Leave it on
            while gathering data; it is not meant to ship.

    config MQJS_PERF_METER
        bool "Latency histograms and worst-case ring (arithmetic core of sys.perf())"
        default y
        help
            Fixed 12-bucket log2 histograms (native-editor-spec.md section
            C.0 rule 3), a worst-16 ring per measured pipeline, and a
            same-core-in/same-core-out span guard for cache-stall-style
            timers. The guard exists because M0a once subtracted two
            different cores' cycle-count CSRs and reported a stall of
            10,177,430 us (section C.0 rule 6) -- perf_span_exit_us()
            checks the core before computing anything, so that mistake
            cannot silently reproduce.

            Pure arithmetic, no ESP-IDF calls beyond reading the core id
            and cycle counter (main/perf_meter.c). Host-testable via
            tools/tests/test_perf_hist.c.

            Off collapses every perf_meter call to a no-op so call sites
            never need their own #ifdef.

    config MQJS_FLASH_SUSPEND_TEST
        bool "Run the flash auto-suspend acceptance test at boot"
        default n
        help
            Writes to littlefs on core 0 while CRC-ing an mmap'd flash
            window on core 1, and reports whether the CRC ever differs.

            This exists because CONFIG_SPI_FLASH_AUTO_SUSPEND fails
            SILENTLY when the configured tSUS is shorter than the flash
            chip needs: the cache reads a chip that is still busy and
            gets garbage, which shows up as a wrong glyph or a wrong
            dictionary line and only during a flash write. Normal
            smoke-testing cannot find that. This turns it into a loud
            mismatch count instead.

            Dev only. It wears flash and steals both cores while it runs.

    config MQJS_FLASH_SUSPEND_TEST_ITERS
        int "Write iterations for the acceptance test"
        default 150
        range 10 5000
        depends on MQJS_FLASH_SUSPEND_TEST
        help
            Each iteration rewrites a 16 KB file, so this many
            iterations is roughly that many erase/program bursts. 150
            takes a couple of minutes; raise it for a soak.

    config MQJS_OPUS_BENCHMARK
        bool "Run real-fixture Opus decoder benchmark at boot"
        default n
        depends on OPUS_PLAYER
        help
            Decode the embedded 48 kbit/s stereo Ogg/Opus fixture without
            audio output before normal application startup. Reports per-pass
            decoder load, packet latency percentiles, and PCM checksums.

    config MQJS_OPUS_BENCH_WARMUP_PASSES
        int "Opus benchmark warmup passes"
        default 1
        range 0 10
        depends on MQJS_OPUS_BENCHMARK

    config MQJS_OPUS_BENCH_PASSES
        int "Opus benchmark measured passes"
        default 5
        range 1 100
        depends on MQJS_OPUS_BENCHMARK

    config MQJS_OPUS_BENCH_MAX_PACKETS
        int "Maximum packets per Opus benchmark fixture"
        default 512
        range 64 4096
        depends on MQJS_OPUS_BENCHMARK
        help
            Bounds the benchmark task's packet-latency arrays. The current
            fixture contains 317 audio packets.

endmenu
```
