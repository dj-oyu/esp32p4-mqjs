## components/esp_opus_float/Kconfig
```kconfig
menu "Opus codec (esp_opus_float)"

config OPUS_FIXED_POINT
    bool "Build Opus in fixed-point arithmetic"
    default n
    help
        Compile the Opus codec with -DFIXED_POINT: the CELT decoder uses
        integer arithmetic and the SILK fixed-point encoder sources are built.

        This is the prerequisite for ESP32-P4 PIE acceleration, whose SIMD is
        integer-only (no float vector instructions). It changes the decoded
        PCM bit-for-bit versus the float path, so validate fixed output
        against the fixed C reference (not the float hash).

        Default off keeps the float decode path and the OPUS_P4_KERNELS_FLOAT
        anti-collapse kernel unchanged.

config OPUS_P4_COMB_PIE
    bool "Use the ESP32-P4 PIE comb filter (fixed-point)"
    default n
    depends on OPUS_FIXED_POINT && IDF_TARGET_ESP32P4
    help
        Route comb_filter_const_c through the PIE kernel opus_p4_comb8 (16x32
        via vmul.s32.s16xs16, unaligned taps via src.q). ~2x faster than scalar
        on the comb filter; relaxed (not bit-exact, ~-64 dB vs the C reference,
        within opus_compare tolerance). Misaligned buffers fall back to C.

config OPUS_P4_DENORM_PIE
    bool "Use the ESP32-P4 PIE denormalise-bands kernel (fixed-point)"
    default n
    depends on OPUS_FIXED_POINT && IDF_TARGET_ESP32P4
    help
        Route the denormalise_bands common path (shift>=0) through the PIE
        kernel opus_p4_denorm8 (16x32 via vmul.s32.s16xs16, contiguous int16
        x via src.q). Relaxed (signed low-half split, ~-78 dB vs the C
        reference, within opus_compare tolerance). The shift<0 extreme-gain
        branch and the per-band tail stay on portable C.

config OPUS_P4_NORMRES_PIE
    bool "Use the ESP32-P4 PIE normalise_residual kernel (fixed-point)"
    default n
    depends on OPUS_FIXED_POINT && IDF_TARGET_ESP32P4
    help
        Route the normalise_residual hot loop through the PIE kernel
        opus_p4_normres8 (16x16 via vmul.s32.s16xs16, int32 iy narrowed with
        vunzip.16, round bias + arithmetic shift, int16 output). Bit-exact
        with the C reference (no relaxed split).

endmenu
```

## components/kbd_tab5/Kconfig
```kconfig
menu "Tab5 Keyboard (A164 dock)"

config MQJS_TAB5_KEYBOARD
    bool "M5Stack Tab5 keyboard dock support"
    depends on MQJS_TAB5_UI
    default y
    help
        Driver for the 70-key Tab5 keyboard dock (I2C 0x6D on the pogo
        connector, SDA=GPIO0 SCL=GPIO1 INT=GPIO50). Hot-pluggable: the
        driver probes for the dock and feeds key events into the same
        ui.onKey stream as the on-screen keyboard.

endmenu
```

## components/opus_p4_kernels/Kconfig
```kconfig
menu "Opus ESP32-P4 kernels"

choice OPUS_P4_KERNEL_MODE
    prompt "Opus kernel implementation"
    default OPUS_P4_KERNEL_PORTABLE

    config OPUS_P4_KERNEL_PORTABLE
        bool "Portable C"

    config OPUS_P4_KERNEL_ASM
        bool "ESP32-P4 asm ABI scaffold"
        depends on IDF_TARGET_ESP32P4
        help
            Route implemented kernel boundaries through their P4 assembly
            symbols. The anti-collapse noise symbol is currently an ABI
            scaffold that tail-calls the portable C reference.

    config OPUS_P4_KERNEL_ASM_VERIFY
        bool "ESP32-P4 asm ABI scaffold with C verification"
        depends on IDF_TARGET_ESP32P4
        help
            Verify the first calls against the portable C contract and latch
            a permanent C fallback on any mismatch. The anti-collapse noise
            symbol is currently an ABI scaffold, not an optimized PIE kernel.
endchoice

config OPUS_P4_VERIFY_CALLS
    int "Calls verified before accepting an asm kernel"
    default 64
    range 1 4096
    depends on OPUS_P4_KERNEL_ASM_VERIFY
    help
        Number of calls checked before a kernel changes from verification to
        direct asm dispatch for the rest of the boot.

config OPUS_P4_FUNCTION_PROFILE
    bool "Instrument Opus functions for profiling"
    default n
    depends on IDF_TARGET_ESP32P4
    help
        Add compiler function instrumentation to esp_opus_float and collect
        approximate per-function self cycles during the boot benchmark.
        Enable only for profiling builds because the overhead is substantial.

endmenu
```

## components/opus_player/Kconfig
```kconfig
menu "Opus playback"

    config OPUS_PLAYER
        bool "Enable Ogg Opus playback"
        default n
        depends on MQJS_TAB5_AUDIO
        help
            Decode an in-memory Ogg Opus stream with the float Opus
            component and send signed 16-bit PCM to audio_tab5.

    config OPUS_PLAYER_BOOT_OPUS
        bool "Embed assets/audio/tab5-boot-48k.opus"
        default n
        depends on OPUS_PLAYER
        help
            Embed the 48 kbit/s stereo Opus fixture so it can be played
            without a filesystem.

    config OPUS_PLAYER_BOOT_AUTOPLAY
        bool "Play the embedded Opus fixture at boot"
        default n
        depends on OPUS_PLAYER_BOOT_OPUS
        depends on !MQJS_TAB5_AUDIO_SELFTEST
        help
            Start asynchronous playback from the UI/I2C ready event.
            Intended for initial device verification.
            The speaker self-test option must be off so only one producer
            owns the PCM stream.

    config OPUS_PLAYER_DIAGNOSTICS
        bool "Log decoded PCM diagnostics"
        default n
        depends on OPUS_PLAYER
        help
            Log the first decoded samples, min/max, and an FNV-1a hash of
            the first 4096 output frames. Intended for decoder validation.

endmenu
```

## components/pwr_tab5/Kconfig
```kconfig
menu "Tab5 battery"

    config MQJS_TAB5_BATTERY
        bool "Enable Tab5 battery monitoring, charge control and protection"
        default n
        depends on IDF_TARGET_ESP32P4
        help
            M5Stack Tab5 battery support: INA226 monitoring (0x41, internal
            I2C bus), charge enable / quick-charge selection through the
            PI4IOE5V6408 expander at 0x44, a coulomb-counting fuel gauge with
            IR compensation, and the load-shed / over-discharge ladder that
            shuts the device down before the pack's 6.0 V protection latches
            (recovering from that needs the battery physically removed).

            Off by default so Stamp-P4 builds are unaffected; when disabled
            pwr_tab5.h provides no-op inline stubs.

            NOTE: without this, a Tab5 never charges. The charger is gated by
            a firmware-driven pin and the device only charges while powered
            on, so a build with this option off drains the pack even on USB.

    config MQJS_TAB5_BATTERY_INVERT_CURRENT
        bool "INA226 current is negative while charging"
        depends on MQJS_TAB5_BATTERY
        default n
        help
            The INA226's orientation on this board is not documented; the
            factory UI treats "current >= 0" as charging and this default
            follows it. Set this if the device reports a discharge while it
            is visibly charging. Also settable at runtime with
            pwr_tab5_set_current_sign(-1) / power.sign(-1) during bring-up,
            so a probe run does not need a reflash.

    config MQJS_TAB5_BATTERY_GRACE_S
        int "Seconds between the shutdown warning and cutting power"
        depends on MQJS_TAB5_BATTERY
        range 5 120
        default 30
        help
            When the pack reaches the shutdown tier, apps are told through
            sys.onStop("battery") and the countdown starts. Power is cut on
            the acknowledgement or when this expires, whichever comes first.
            A charger appearing during the countdown aborts it.

endmenu
```

## components/sdcard/Kconfig
```kconfig
menu "microSD card"

    config MQJS_SDCARD
        bool "Mount a microSD card as the 'sd' volume"
        default n
        help
            Registers a removable FAT volume with fs_core. Off by default:
            Stamp-P4 has no card slot and its C6 co-processor already owns
            the pins the Tab5 wires to SDMMC, so enabling this there would
            fight the Wi-Fi link. Tab5 builds turn it on via
            sdkconfig.tab5.defaults.

            The pin defaults below are the Tab5 wiring (SDMMC slot 0 IOMUX).
            Keeping them in Kconfig rather than in the C is what lets the
            same driver serve another board — see
            docs/filer-storage-design.md section 3.

    if MQJS_SDCARD

    config MQJS_SDCARD_SLOT
        int "SDMMC slot"
        default 0
        range 0 1
        help
            Tab5 uses slot 0 (fixed IOMUX pins 39-44). Slot 1 is taken by
            the esp-hosted C6 link on both boards, so 1 is almost certainly
            wrong here.

    config MQJS_SDCARD_WIDTH
        int "Bus width (1 or 4)"
        default 4
        range 1 4

    config MQJS_SDCARD_PIN_CLK
        int "CLK GPIO"
        default 43

    config MQJS_SDCARD_PIN_CMD
        int "CMD GPIO"
        default 44

    config MQJS_SDCARD_PIN_D0
        int "D0 GPIO"
        default 39

    config MQJS_SDCARD_PIN_D1
        int "D1 GPIO"
        default 40

    config MQJS_SDCARD_PIN_D2
        int "D2 GPIO"
        default 41

    config MQJS_SDCARD_PIN_D3
        int "D3 GPIO"
        default 42

    config MQJS_SDCARD_LDO_CHAN
        int "On-chip LDO channel powering the card's IO rail (0 = none)"
        default 4
        range 0 4
        help
            Tab5 feeds VDD_SDIO from internal LDO channel 4. Channels 1-3
            are already spoken for (flash, PSRAM, MIPI DSI PHY). Set 0 on a
            board whose card is powered externally.

    config MQJS_SDCARD_LDO_MV
        int "LDO output voltage (mV)"
        default 3300
        depends on MQJS_SDCARD_LDO_CHAN != 0

    config MQJS_SDCARD_FREQ_KHZ
        int "Bus clock (kHz)"
        default 40000
        help
            40000 = SDMMC_FREQ_HIGHSPEED. Drop to 20000 if a card is flaky.

    config MQJS_SDCARD_MAX_FILES
        int "Maximum simultaneously open files"
        default 5
        range 1 16

    endif

endmenu
```

## components/ui_tab5/Kconfig
```kconfig
menu "Tab5 on-device UI"

    config MQJS_TAB5_UI
        bool "Enable Tab5 on-device UI (MIPI-DSI + LVGL)"
        default n
        depends on IDF_TARGET_ESP32P4
        help
            Drive the M5Stack Tab5 5" 1280x720 MIPI-DSI panel (ILI9881C)
            with LVGL: status bar, JS console, and (later) ui.* drawing
            bindings. Off by default so Stamp-P4 builds are unaffected;
            when disabled ui_tab5.h provides no-op inline stubs.

    config MQJS_UI_GEOM_PROBE
        bool "Geometry probe for the landscape PPA rotate hang (E2)"
        default n
        depends on MQJS_TAB5_UI
        help
            Diagnostic only. Adds ui_tab5_geom_probe(): on the UI task it
            invalidates a transparent top-layer object of fixed sizes
            (1280x28, 1280x7, 1137x8, 1138x7, 1137x7, 1137x31) one at a
            time and forces a refresh, logging GEOM_PROBE lines. In
            landscape each size becomes one PPA SRM rotate of exactly
            that chunk geometry, so the step that never prints "done"
            names the geometry that hangs. Triggered explicitly from the
            native editor with Ctrl+G (dock). Nothing runs unless the key
            is pressed.

endmenu
```
